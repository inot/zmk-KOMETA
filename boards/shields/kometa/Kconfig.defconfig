## boards/shields/kometa/Kconfig.defconfig
```kconfig
if SHIELD_KOMETA_LEFT

config ZMK_KEYBOARD_NAME
    default "kometa"

endif

if SHIELD_KOMETA_DONGLE

config ZMK_KEYBOARD_NAME
    default "kometa"

config ZMK_SPLIT_ROLE_CENTRAL
    default y

config ZMK_SPLIT
    default y

config ZMK_SPLIT_BLE_CENTRAL_PERIPHERALS
    default 2

config BT_MAX_CONN
    default 7

config BT_MAX_PAIRED
    default 7

endif

if SHIELD_KOMETA_LEFT || SHIELD_KOMETA_RIGHT

config ZMK_SPLIT
    default y

config ZMK_BLE
    default y

endif
```

## boards/shields/kometa/Kconfig.shield
```kconfig
config SHIELD_KOMETA_LEFT
    def_bool $(shields_list_contains,kometa_left)

config SHIELD_KOMETA_RIGHT
    def_bool $(shields_list_contains,kometa_right)

config SHIELD_KOMETA_DONGLE
    def_bool $(shields_list_contains,kometa_dongle)
```
